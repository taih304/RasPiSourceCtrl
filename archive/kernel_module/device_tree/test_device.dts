/dts-v1/;
/plugin/;
/ {
    compatible = "brcm,bcm2835";
    fragment@0 {
        target-path = "/";
        __overlay__ {
            my_device {
                compatible = "my_property,mydev";
                status = "okay";
                label = "test";
                my_value = <12>;
            };
        };
    };
};